## Config.in
```kconfig
source "$BR2_EXTERNAL_LVGL_PATH/package/lvgl/Config.in"
source "$BR2_EXTERNAL_LVGL_PATH/package/lv_drivers/Config.in"
source "$BR2_EXTERNAL_LVGL_PATH/package/lv_demos/Config.in"
```

## package/lv_br2_sample/Config.in
```kconfig
config BR2_PACKAGE_LV_BR2_SAMPLE
	bool "lv_sample"
	depends on BR2_TOOLCHAIN_BUILDROOT_CXX
```

## package/lv_demos/Config.in
```kconfig
config BR2_PACKAGE_LV_DEMOS
	bool "lv_demos"
	depends on BR2_TOOLCHAIN_BUILDROOT_CXX
```

## package/lv_drivers/Config.in
```kconfig
config BR2_PACKAGE_LV_DRIVERS
	bool "lv_drivers"
	depends on BR2_TOOLCHAIN_BUILDROOT_CXX
```

## package/lv_sim_eclipse_sdl/Config.in
```kconfig
config BR2_PACKAGE_LV_SIM_ECLIPSE_SDL
	bool "lv_sim_ecliplse_sdl"
	depends on BR2_TOOLCHAIN_BUILDROOT_CXX
```
